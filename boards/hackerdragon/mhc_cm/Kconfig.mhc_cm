## boards/hackerdragon/mhc_cm/Kconfig.mhc_cm
```kconfig
# Copyright (c) 2026 MASSDRIVER EI (massdriver.space)
# SPDX-License-Identifier: Apache-2.0

config BOARD_MHC_CM
	select SOC_RP2350B_HAZARD3 if BOARD_MHC_CM_RP2350B_HAZARD3
	select SOC_RP2350B_M33 if BOARD_MHC_CM_RP2350B_M33
```

## boards/hackerdragon/mhc_cm/board.yml
```yaml
board:
  name: mhc_cm
  full_name: MotorHomeControl ControlModule
  vendor: Hackerdragon
  socs:
    - name: rp2350b
```

## drivers/sensor/maxim/ds1621/Kconfig
```kconfig
# DS1621 temperature sensor configuration options

# Copyright (c) 2026 Adrian Dummermuth
# SPDX-License-Identifier: Apache-2.0

config DS1621
	bool "DS1621"
	default y
	depends on DT_HAS_MAXIM_DS1621_ENABLED
	select I2C
	help
	  Enable driver for DS1621 I2C-based temperature sensor.
```

## drivers/sensor/ti/ina4235/Kconfig
```kconfig
# INA4235 Quad Current and Power Monitor

# Copyright 2026 Adrian Dummermuth
# SPDX-License-Identifier: Apache-2.0

config INA4235
	bool "INA4235 Quad Current and Power Monitor"
	default y
	depends on DT_HAS_TI_INA4235_ENABLED
	select I2C
	help
	  Enable driver for INA4235 Current and Power Monitor.
```

## dts/bindings/sensor/maxim,ds1621.yaml
```yaml
# Copyright (c) 2026 Adrian Dummermuth <mail+github@hackerdragon.ch>
#
# SPDX-License-Identifier: Apache-2.0
#

description: Maxim DS1621 I2C temperature sensor

compatible: "maxim,ds1621"

include: [sensor-device.yaml]
```
